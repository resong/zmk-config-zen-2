#include <behaviors.dtsi>
#include <dt-bindings/zmk/keys.h>

#include <layers.h>

/ {
    behaviors {
      nn_lt: nn_lt {
        compatible = "zmk,behavior-hold-tap";
        label = "nn_lt";
        #binding-cells = <2>;
        tapping-term-ms = <175>;
        flavor = "tap-preferred";
        bindings = <&mo NAV>, <&lt NUM>;
      };
      sn_lt: sn_lt {
        compatible = "zmk,behavior-hold-tap";
        label = "sn_lt";
        #binding-cells = <2>;
        tapping-term-ms = <175>;
        flavor = "tap-preferred";
        bindings = <&mo SYM>, <&lt DEFAULT>;
      };
    };
};